## Documentation/devicetree/bindings/net/bluetooth/qcom,qcc2072-bt.yaml
```yaml
# SPDX-License-Identifier: (GPL-2.0 OR BSD-2-Clause)
%YAML 1.2
---
$id: http://devicetree.org/schemas/net/bluetooth/qcom,qcc2072-bt.yaml#
$schema: http://devicetree.org/meta-schemas/core.yaml#

title: Qualcomm QCC2072 Bluetooth

maintainers:
  - Balakrishna Godavarthi <quic_bgodavar@quicinc.com>
  - Rocky Liao <quic_rjliao@quicinc.com>

description:
  Qualcomm QCC2072 is a UART-based Bluetooth controller.

properties:
  compatible:
    enum:
      - qcom,qcc2072-bt

  enable-gpios:
    maxItems: 1
    description: GPIO specifier for the chip interrupt.

required:
  - compatible
  - enable-gpios

allOf:
  - $ref: bluetooth-controller.yaml#
  - $ref: qcom,bluetooth-common.yaml
  - $ref: /schemas/serial/serial-peripheral-props.yaml#

unevaluatedProperties: false

examples:
  - |
    #include <dt-bindings/gpio/gpio.h>
    #include <dt-bindings/interrupt-controller/irq.h>

    serial {
        bluetooth {
            compatible = "qcom,qcc2072-bt";
            enable-gpios = <&tlmm 19 IRQ_TYPE_EDGE_FALLING>;
            max-speed = <3200000>;
        };
    };
```
